## subsys/logging/backends/Kconfig.adsp_mtrace
```kconfig
# Copyright (c) 2021 Nordic Semiconductor ASA
# SPDX-License-Identifier: Apache-2.0

config LOG_BACKEND_ADSP_MTRACE
	bool "Intel ADSP mtrace backend"
	depends on SOC_FAMILY_INTEL_ADSP
	select LOG_BACKEND_SUPPORTS_FORMAT_TIMESTAMP
	help
	  Provide a logging backend which writes to SRAM window
	  using the SOF Linux driver mtrace buffer layout.

if LOG_BACKEND_ADSP_MTRACE

backend = ADSP_MTRACE
backend-str = adsp_mtrace
source "subsys/logging/Kconfig.template.log_format_config"

config LOG_MSG_MULTI_SLOT
	bool "Append originating CPU core ID to log messages"
	depends on SMP
	depends on INTEL_ADSP_DEBUG_SLOT_MANAGER
	help
	  When enabled, each log message stores the CPU core ID of the
	  originating core. This allows the mtrace backend to route
	  messages to per-core debug window slots.

endif # LOG_BACKEND_ADSP_MTRACE
```
